## main/Kconfig.projbuild
```kconfig
menu "Connection Configuration"

    config ESP_WIFI_SSID
        string "WiFi SSID"
        default "YOUR-SSID"
        help
            SSID (network name) for the example to connect to.

    config ESP_WIFI_PASSWORD
        string "WiFi Password"
        default "YOUR-PASSWORD"
        help
            WiFi password (WPA or WPA2) for the example to use.

    config MQTT_BROKER_URL
            string "MQTT Broker URL"
            default "mqtt://localhost:1883"
            help
                MQTT Broker URL to publish commands and subscribe to statuses

    config MQTT_PUBLISH_TOPIC
            string "MQTT Publish Topic"
            default "iot.light.switch"
            help
                MQTT publish topic to impact subcribed lights

    config LIGHT_ON_CODE
        string "Code that represents the light being on"
        default "1"

    config LIGHT_OFF_CODE
        string "Code that represents the light being off"
        default "0"
endmenu
```
